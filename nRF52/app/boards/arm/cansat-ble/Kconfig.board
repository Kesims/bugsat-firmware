## nRF52/app/boards/arm/cansat-ble/Kconfig.board
```kconfig
# Copyright (c) 2023 Nordic Semiconductor ASA
# SPDX-License-Identifier: Apache-2.0

config BOARD_CANSAT_BLE
	bool "cansat-ble"
	depends on SOC_NRF52833_QDAA
```

## nRF52/app/boards/arm/cansat-ble/Kconfig.defconfig
```kconfig
# Copyright (c) 2023 Nordic Semiconductor ASA
# SPDX-License-Identifier: Apache-2.0

if BOARD_CANSAT_BLE

config BOARD
	default "cansat_ble"

config BT_CTLR
   default BT

endif
```
